## yocto/meta-headunit/wic/headunit-ab.wks
```
part /boot --source bootimg-partition \
    --ondisk mmcblk0 \
    --fstype=vfat \
    --label boot \
    --active \
    --align 4 \
    --size 128

part / --source rootfs \
    --ondisk mmcblk0 \
    --fstype=ext4 \
    --label rootfsA \
    --align 4 \
    --size 2048

part / --ondisk mmcblk0 \
    --fstype=ext4 \
    --label rootfsB \
    --align 4 \
    --size 2048

part /data \
    --ondisk mmcblk0 \
    --fstype=ext4 \
    --label data \
    --align 4 \
    --size 512

bootloader --ptable msdos
```
