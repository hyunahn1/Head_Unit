## SEA-ME-Students-main/Head_Unit-Yocto/yocto/build-rpi/conf/bblayers.conf
```bitbake
# POKY_BBLAYERS_CONF_VERSION is increased each time build/conf/bblayers.conf
# changes incompatibly
POKY_BBLAYERS_CONF_VERSION = "2"

BBPATH = "${TOPDIR}"
BBFILES ?= ""

BBLAYERS ?= " \
  /home/seame/SEA_ME/Head_Unit/yocto/poky/meta \
  /home/seame/SEA_ME/Head_Unit/yocto/poky/meta-poky \
  /home/seame/SEA_ME/Head_Unit/yocto/poky/meta-yocto-bsp \
  /home/seame/SEA_ME/Head_Unit/yocto/meta-openembedded/meta-oe \
  /home/seame/SEA_ME/Head_Unit/yocto/meta-openembedded/meta-python \
  /home/seame/SEA_ME/Head_Unit/yocto/meta-openembedded/meta-multimedia \
  /home/seame/SEA_ME/Head_Unit/yocto/meta-openembedded/meta-networking \
  /home/seame/SEA_ME/Head_Unit/yocto/meta-raspberrypi \
  /home/seame/SEA_ME/Head_Unit/yocto/meta-qt5 \
  /home/seame/SEA_ME/Head_Unit/yocto/meta-piracer \
  "
```

## yocto/build-pir/conf/bblayers.conf
```bitbake
# POKY_BBLAYERS_CONF_VERSION is increased each time build/conf/bblayers.conf
# changes incompatibly
POKY_BBLAYERS_CONF_VERSION = "2"

BBPATH = "${TOPDIR}"
BBFILES ?= ""

BBLAYERS ?= " \
  /home/seame/SEA_ME/Head_Unit/yocto/poky/meta \
  /home/seame/SEA_ME/Head_Unit/yocto/poky/meta-poky \
  /home/seame/SEA_ME/Head_Unit/yocto/poky/meta-yocto-bsp \
  "
```
